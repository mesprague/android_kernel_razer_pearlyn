## drivers/misc/rzr/Kconfig
```kconfig
config RZR_DEVMODE
	bool "Razer 'Device Mode' for USB Port"
	depends on ARCH_APQ8084
	default n

config RZR_FILTER
	bool "Razer Filter"
	depends on ARCH_APQ8084
	default n
```
